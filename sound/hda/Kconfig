## sound/hda/Kconfig
```kconfig
config SND_HDA_CORE
	tristate
	select REGMAP

config SND_HDA_DSP_LOADER
	bool

config SND_HDA_COMPONENT
	bool

config SND_HDA_I915
	bool
	select SND_HDA_COMPONENT

config SND_HDA_EXT_CORE
       tristate
       select SND_HDA_CORE

config SND_HDA_PREALLOC_SIZE
	int "Pre-allocated buffer size for HD-audio driver"
	range 0 32768
	default 64
	help
	  Specifies the default pre-allocated buffer-size in kB for the
	  HD-audio driver.  A larger buffer (e.g. 2048) is preferred
	  for systems using PulseAudio.  The default 64 is chosen just
	  for compatibility reasons.

	  Note that the pre-allocation size can be changed dynamically
	  via a proc file (/proc/asound/card*/pcm*/sub*/prealloc), too.

config SND_HDA_CODEC_HDMI
    tristate "Build HDMI/DisplayPort HD-audio codec support"
    select SND_DYNAMIC_MINORS
    help
        Say Y or M here to include HDMI and DisplayPort HD-audio codec
        support in snd-hda-intel driver.  This includes all AMD/ATI,
        Intel and Nvidia HDMI/DisplayPort codecs.
        Note that this option mandatorily enables CONFIG_SND_DYNAMIC_MINORS
        to assure the multiple streams for DP-MST support.

config HDMI_LPE_AUDIO
    tristate "HDMI audio without HDaudio on Intel Atom platforms"
    depends on DRM_I915
    select SND_PCM
    help
        Choose this option to support HDMI LPE Audio mode
```
